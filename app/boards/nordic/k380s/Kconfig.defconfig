## app/boards/nordic/k380s/Kconfig.defconfig
```kconfig
# Copyright (c) 2024 The ZMK Contributors
# SPDX-License-Identifier: MIT

config ZMK_KEYBOARD_NAME
    default "zmk-K380s" if BOARD_K380S
```

## app/boards/nordic/k380s/Kconfig.k380s
```kconfig
# TyK380v2 board configuration
#
# Copyright (c) 2024 The ZMK Contributors
# SPDX-License-Identifier: MIT

config BOARD_K380S
    select SOC_NRF52832_QFAB
    select ZMK_BOARD_COMPAT
```

## app/boards/nordic/k380s/board.yml
```yaml
board:
  name: k380s
  vendor: nordic
  socs:
    - name: nrf52832
      variants:
        - name: zmk
```
